## components/fluid_app/Kconfig.projbuild
```kconfig
menu "Fluid simulation"

    config FLUID_CELL_PX
        int "Pressure grid cell size (px)"
        range 6 16
        default 10
        help
            Main quality/cost knob. Smaller cells mean more particles and finer
            detail, and cost roughly quadratically more CPU.

    config FLUID_FILL_PERCENT
        int "Share of the screen filled with fluid (%)"
        range 10 70
        default 40

    config FLUID_SUBSTEPS
        int "Simulation substeps per frame"
        range 1 4
        default 1

    config FLUID_PRESSURE_ITERS
        int "Pressure solver iterations per substep"
        range 5 60
        default 20
        help
            Red-black Gauss-Seidel, split across both cores. 20 is visually the
            same as 30 in tools/host_bench.

    config FLUID_GRAVITY_PX_PER_G
        int "Gravity scale (px/s^2 per g)"
        range 300 6000
        default 1800
        help
            How fast the fluid falls. Real scale would be far too fast; ~1800
            makes the screen feel like a ~0.3 m tall tank.

    config FLUID_BRIGHTNESS
        int "Display brightness (%)"
        range 10 100
        default 80
        help
            Initial value; the menu (PWR) changes it and saves it in NVS.

    config FLUID_CLOCK_DEFAULT
        bool "Show the clock digits by default"
        default y
        help
            The hour and minutes become walls the fluid flows around. Toggle in
            the menu (PWR); the choice is saved in NVS.

    config FLUID_RTC_SET_FROM_BUILD
        bool "Set the RTC to the build time on every boot"
        default n
        help
            Off: the build time is only written when the RTC lost its time
            (battery out). The time can also be set from the menu.

endmenu
```
